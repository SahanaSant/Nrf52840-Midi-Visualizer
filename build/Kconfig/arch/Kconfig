## build/Kconfig/arch/Kconfig
```kconfig
# Load Zephyr Arch Kconfig descriptions.
osource "C:/Users/sahan/zephyr-projects/zephyr/arch/rx/Kconfig"
osource "C:/Users/sahan/zephyr-projects/zephyr/arch/x86/Kconfig"
osource "C:/Users/sahan/zephyr-projects/zephyr/arch/xtensa/Kconfig"
osource "C:/Users/sahan/zephyr-projects/zephyr/arch/sparc/Kconfig"
osource "C:/Users/sahan/zephyr-projects/zephyr/arch/riscv/Kconfig"
osource "C:/Users/sahan/zephyr-projects/zephyr/arch/posix/Kconfig"
osource "C:/Users/sahan/zephyr-projects/zephyr/arch/mips/Kconfig"
osource "C:/Users/sahan/zephyr-projects/zephyr/arch/arm64/Kconfig"
osource "C:/Users/sahan/zephyr-projects/zephyr/arch/arm/Kconfig"
osource "C:/Users/sahan/zephyr-projects/zephyr/arch/arc/Kconfig"
```

## build/Kconfig/boards/Kconfig
```kconfig
# Load Zephyr board Kconfig descriptions.
osource "C:/Users/sahan/zephyr-projects/zephyr/boards/nordic/nrf52840dk/Kconfig"
```

## build/Kconfig/boards/Kconfig.defconfig
```kconfig
# Load Zephyr board defconfig descriptions.
osource "C:/Users/sahan/zephyr-projects/zephyr/boards/nordic/nrf52840dk/Kconfig.defconfig"
```

## build/Kconfig/boards/Kconfig.nrf52840dk
```kconfig
# Load board Kconfig descriptions.
osource "C:/Users/sahan/zephyr-projects/zephyr/boards/nordic/nrf52840dk/Kconfig.nrf52840dk"
```

## build/Kconfig/boards/Kconfig.sysbuild
```kconfig
# Load Sysbuild board Kconfig descriptions.
osource "C:/Users/sahan/zephyr-projects/zephyr/boards/nordic/nrf52840dk/Kconfig.sysbuild"
```

## build/Kconfig/soc/Kconfig
```kconfig
# Load Zephyr SoC Kconfig descriptions.
osource "C:/Users/sahan/zephyr-projects/zephyr/soc/xlnx/zynqmp/Kconfig"
osource "C:/Users/sahan/zephyr-projects/zephyr/soc/xlnx/zynq7000/Kconfig"
osource "C:/Users/sahan/zephyr-projects/zephyr/soc/xlnx/versalnet/Kconfig"
osource "C:/Users/sahan/zephyr-projects/zephyr/soc/xlnx/versal2/Kconfig"
osource "C:/Users/sahan/zephyr-projects/zephyr/soc/xen/Kconfig"
osource "C:/Users/sahan/zephyr-projects/zephyr/soc/wch/ch32v/Kconfig"
osource "C:/Users/sahan/zephyr-projects/zephyr/soc/ti/simplelink/Kconfig"
osource "C:/Users/sahan/zephyr-projects/zephyr/soc/ti/mspm0/Kconfig"
osource "C:/Users/sahan/zephyr-projects/zephyr/soc/ti/lm3s6965/Kconfig"
osource "C:/Users/sahan/zephyr-projects/zephyr/soc/ti/k3/Kconfig"
osource "C:/Users/sahan/zephyr-projects/zephyr/soc/telink/tlsr/Kconfig"
osource "C:/Users/sahan/zephyr-projects/zephyr/soc/starfive/jh71xx/Kconfig"
osource "C:/Users/sahan/zephyr-projects/zephyr/soc/st/stm32/Kconfig"
osource "C:/Users/sahan/zephyr-projects/zephyr/soc/snps/qemu_arc/Kconfig"
osource "C:/Users/sahan/zephyr-projects/zephyr/soc/snps/nsim/arc_v/Kconfig"
osource "C:/Users/sahan/zephyr-projects/zephyr/soc/snps/nsim/arc_classic/Kconfig"
osource "C:/Users/sahan/zephyr-projects/zephyr/soc/snps/hsdk4xd/Kconfig"
osource "C:/Users/sahan/zephyr-projects/zephyr/soc/snps/hsdk/Kconfig"
osource "C:/Users/sahan/zephyr-projects/zephyr/soc/snps/emsk/Kconfig"
osource "C:/Users/sahan/zephyr-projects/zephyr/soc/snps/emsdp/Kconfig"
osource "C:/Users/sahan/zephyr-projects/zephyr/soc/snps/arc_iot/Kconfig"
osource "C:/Users/sahan/zephyr-projects/zephyr/soc/silabs/Kconfig"
osource "C:/Users/sahan/zephyr-projects/zephyr/soc/sifive/sifive_freedom/Kconfig"
osource "C:/Users/sahan/zephyr-projects/zephyr/soc/sensry/Kconfig"
osource "C:/Users/sahan/zephyr-projects/zephyr/soc/rockchip/Kconfig"
osource "C:/Users/sahan/zephyr-projects/zephyr/soc/renode/riscv_virtual/Kconfig"
osource "C:/Users/sahan/zephyr-projects/zephyr/soc/renode/cortex_r8_virtual/Kconfig"
osource "C:/Users/sahan/zephyr-projects/zephyr/soc/renesas/smartbond/Kconfig"
osource "C:/Users/sahan/zephyr-projects/zephyr/soc/renesas/rz/Kconfig"
osource "C:/Users/sahan/zephyr-projects/zephyr/soc/renesas/rx/Kconfig"
osource "C:/Users/sahan/zephyr-projects/zephyr/soc/renesas/rcar/Kconfig"
osource "C:/Users/sahan/zephyr-projects/zephyr/soc/renesas/ra/Kconfig"
osource "C:/Users/sahan/zephyr-projects/zephyr/soc/realtek/ec/Kconfig"
osource "C:/Users/sahan/zephyr-projects/zephyr/soc/raspberrypi/rpi_pico/Kconfig"
osource "C:/Users/sahan/zephyr-projects/zephyr/soc/quicklogic/eos_s3/Kconfig"
osource "C:/Users/sahan/zephyr-projects/zephyr/soc/qemu/virt_riscv/Kconfig"
osource "C:/Users/sahan/zephyr-projects/zephyr/soc/qemu/malta/Kconfig"
osource "C:/Users/sahan/zephyr-projects/zephyr/soc/openisa/rv32m1/Kconfig"
osource "C:/Users/sahan/zephyr-projects/zephyr/soc/openhwgroup/cva6/Kconfig"
osource "C:/Users/sahan/zephyr-projects/zephyr/soc/oct/osd32mp15x/Kconfig"
osource "C:/Users/sahan/zephyr-projects/zephyr/soc/nxp/s32/Kconfig"
osource "C:/Users/sahan/zephyr-projects/zephyr/soc/nxp/rw/Kconfig"
osource "C:/Users/sahan/zephyr-projects/zephyr/soc/nxp/mcx/Kconfig"
osource "C:/Users/sahan/zephyr-projects/zephyr/soc/nxp/lpc/Kconfig"
osource "C:/Users/sahan/zephyr-projects/zephyr/soc/nxp/layerscape/Kconfig"
osource "C:/Users/sahan/zephyr-projects/zephyr/soc/nxp/kinetis/Kconfig"
osource "C:/Users/sahan/zephyr-projects/zephyr/soc/nxp/imxrt/Kconfig"
osource "C:/Users/sahan/zephyr-projects/zephyr/soc/nxp/imx/Kconfig"
osource "C:/Users/sahan/zephyr-projects/zephyr/soc/nuvoton/numicro/Kconfig"
osource "C:/Users/sahan/zephyr-projects/zephyr/soc/nuvoton/numaker/Kconfig"
osource "C:/Users/sahan/zephyr-projects/zephyr/soc/nuvoton/npcx/Kconfig"
osource "C:/Users/sahan/zephyr-projects/zephyr/soc/nuvoton/npcm/Kconfig"
osource "C:/Users/sahan/zephyr-projects/zephyr/soc/nordic/Kconfig"
osource "C:/Users/sahan/zephyr-projects/zephyr/soc/neorv32/Kconfig"
osource "C:/Users/sahan/zephyr-projects/zephyr/soc/native/inf_clock/Kconfig"
osource "C:/Users/sahan/zephyr-projects/zephyr/soc/microchip/sam/Kconfig"
osource "C:/Users/sahan/zephyr-projects/zephyr/soc/microchip/miv/Kconfig"
osource "C:/Users/sahan/zephyr-projects/zephyr/soc/microchip/mec/Kconfig"
osource "C:/Users/sahan/zephyr-projects/zephyr/soc/mediatek/mt8xxx/Kconfig"
osource "C:/Users/sahan/zephyr-projects/zephyr/soc/lowrisc/opentitan/Kconfig"
osource "C:/Users/sahan/zephyr-projects/zephyr/soc/litex/litex_vexriscv/Kconfig"
osource "C:/Users/sahan/zephyr-projects/zephyr/soc/ite/ec/Kconfig"
osource "C:/Users/sahan/zephyr-projects/zephyr/soc/intel/raptor_lake/Kconfig"
osource "C:/Users/sahan/zephyr-projects/zephyr/soc/intel/lakemont/Kconfig"
osource "C:/Users/sahan/zephyr-projects/zephyr/soc/intel/intel_socfpga_std/Kconfig"
osource "C:/Users/sahan/zephyr-projects/zephyr/soc/intel/intel_socfpga/Kconfig"
osource "C:/Users/sahan/zephyr-projects/zephyr/soc/intel/intel_niosv/Kconfig"
osource "C:/Users/sahan/zephyr-projects/zephyr/soc/intel/intel_ish/Kconfig"
osource "C:/Users/sahan/zephyr-projects/zephyr/soc/intel/intel_adsp/Kconfig"
osource "C:/Users/sahan/zephyr-projects/zephyr/soc/intel/elkhart_lake/Kconfig"
osource "C:/Users/sahan/zephyr-projects/zephyr/soc/intel/atom/Kconfig"
osource "C:/Users/sahan/zephyr-projects/zephyr/soc/intel/apollo_lake/Kconfig"
osource "C:/Users/sahan/zephyr-projects/zephyr/soc/intel/alder_lake/Kconfig"
osource "C:/Users/sahan/zephyr-projects/zephyr/soc/infineon/cat3/Kconfig"
osource "C:/Users/sahan/zephyr-projects/zephyr/soc/infineon/cat1c/Kconfig"
osource "C:/Users/sahan/zephyr-projects/zephyr/soc/infineon/cat1b/Kconfig"
osource "C:/Users/sahan/zephyr-projects/zephyr/soc/infineon/cat1a/Kconfig"
osource "C:/Users/sahan/zephyr-projects/zephyr/soc/gd/gd32/Kconfig"
osource "C:/Users/sahan/zephyr-projects/zephyr/soc/gaisler/leon3/Kconfig"
osource "C:/Users/sahan/zephyr-projects/zephyr/soc/gaisler/gr716a/Kconfig"
osource "C:/Users/sahan/zephyr-projects/zephyr/soc/espressif/Kconfig"
osource "C:/Users/sahan/zephyr-projects/zephyr/soc/ene/kb1200/Kconfig"
osource "C:/Users/sahan/zephyr-projects/zephyr/soc/ene/kb106x/Kconfig"
osource "C:/Users/sahan/zephyr-projects/zephyr/soc/efinix/sapphire/Kconfig"
osource "C:/Users/sahan/zephyr-projects/zephyr/soc/cdns/xtensa_sample_controller/Kconfig"
osource "C:/Users/sahan/zephyr-projects/zephyr/soc/cdns/sample_controller32/Kconfig"
osource "C:/Users/sahan/zephyr-projects/zephyr/soc/cdns/dc233c/Kconfig"
osource "C:/Users/sahan/zephyr-projects/zephyr/soc/brcm/bcmvk/Kconfig"
osource "C:/Users/sahan/zephyr-projects/zephyr/soc/brcm/bcm2712/Kconfig"
osource "C:/Users/sahan/zephyr-projects/zephyr/soc/brcm/bcm2711/Kconfig"
osource "C:/Users/sahan/zephyr-projects/zephyr/soc/bflb/Kconfig"
osource "C:/Users/sahan/zephyr-projects/zephyr/soc/atmel/sam0/Kconfig"
osource "C:/Users/sahan/zephyr-projects/zephyr/soc/atmel/sam/Kconfig"
osource "C:/Users/sahan/zephyr-projects/zephyr/soc/aspeed/Kconfig"
osource "C:/Users/sahan/zephyr-projects/zephyr/soc/arm/Kconfig"
osource "C:/Users/sahan/zephyr-projects/zephyr/soc/arm/beetle/Kconfig"
osource "C:/Users/sahan/zephyr-projects/zephyr/soc/antmicro/myra/Kconfig"
osource "C:/Users/sahan/zephyr-projects/zephyr/soc/andestech/Kconfig"
osource "C:/Users/sahan/zephyr-projects/zephyr/soc/amd/acp_6_0/Kconfig"
osource "C:/Users/sahan/zephyr-projects/zephyr/soc/ambiq/Kconfig"
osource "C:/Users/sahan/zephyr-projects/zephyr/soc/aesc/Kconfig"
osource "C:/Users/sahan/zephyr-projects/zephyr/soc/adi/max32/Kconfig"
```
