## build/Kconfig/soc/Kconfig.defconfig
```kconfig
# Load Zephyr SoC defconfig descriptions.
osource "C:/Users/sahan/zephyr-projects/zephyr/soc/xlnx/zynqmp/Kconfig.defconfig"
osource "C:/Users/sahan/zephyr-projects/zephyr/soc/xlnx/zynq7000/Kconfig.defconfig"
osource "C:/Users/sahan/zephyr-projects/zephyr/soc/xlnx/versalnet/Kconfig.defconfig"
osource "C:/Users/sahan/zephyr-projects/zephyr/soc/xlnx/versal2/Kconfig.defconfig"
osource "C:/Users/sahan/zephyr-projects/zephyr/soc/xen/Kconfig.defconfig"
osource "C:/Users/sahan/zephyr-projects/zephyr/soc/wch/ch32v/Kconfig.defconfig"
osource "C:/Users/sahan/zephyr-projects/zephyr/soc/ti/simplelink/Kconfig.defconfig"
osource "C:/Users/sahan/zephyr-projects/zephyr/soc/ti/mspm0/Kconfig.defconfig"
osource "C:/Users/sahan/zephyr-projects/zephyr/soc/ti/lm3s6965/Kconfig.defconfig"
osource "C:/Users/sahan/zephyr-projects/zephyr/soc/ti/k3/Kconfig.defconfig"
osource "C:/Users/sahan/zephyr-projects/zephyr/soc/telink/tlsr/Kconfig.defconfig"
osource "C:/Users/sahan/zephyr-projects/zephyr/soc/starfive/jh71xx/Kconfig.defconfig"
osource "C:/Users/sahan/zephyr-projects/zephyr/soc/st/stm32/Kconfig.defconfig"
osource "C:/Users/sahan/zephyr-projects/zephyr/soc/snps/qemu_arc/Kconfig.defconfig"
osource "C:/Users/sahan/zephyr-projects/zephyr/soc/snps/nsim/arc_v/Kconfig.defconfig"
osource "C:/Users/sahan/zephyr-projects/zephyr/soc/snps/nsim/arc_classic/Kconfig.defconfig"
osource "C:/Users/sahan/zephyr-projects/zephyr/soc/snps/hsdk4xd/Kconfig.defconfig"
osource "C:/Users/sahan/zephyr-projects/zephyr/soc/snps/hsdk/Kconfig.defconfig"
osource "C:/Users/sahan/zephyr-projects/zephyr/soc/snps/emsk/Kconfig.defconfig"
osource "C:/Users/sahan/zephyr-projects/zephyr/soc/snps/emsdp/Kconfig.defconfig"
osource "C:/Users/sahan/zephyr-projects/zephyr/soc/snps/arc_iot/Kconfig.defconfig"
osource "C:/Users/sahan/zephyr-projects/zephyr/soc/silabs/Kconfig.defconfig"
osource "C:/Users/sahan/zephyr-projects/zephyr/soc/sifive/sifive_freedom/Kconfig.defconfig"
osource "C:/Users/sahan/zephyr-projects/zephyr/soc/sensry/Kconfig.defconfig"
osource "C:/Users/sahan/zephyr-projects/zephyr/soc/rockchip/Kconfig.defconfig"
osource "C:/Users/sahan/zephyr-projects/zephyr/soc/renode/riscv_virtual/Kconfig.defconfig"
osource "C:/Users/sahan/zephyr-projects/zephyr/soc/renode/cortex_r8_virtual/Kconfig.defconfig"
osource "C:/Users/sahan/zephyr-projects/zephyr/soc/renesas/smartbond/Kconfig.defconfig"
osource "C:/Users/sahan/zephyr-projects/zephyr/soc/renesas/rz/Kconfig.defconfig"
osource "C:/Users/sahan/zephyr-projects/zephyr/soc/renesas/rx/Kconfig.defconfig"
osource "C:/Users/sahan/zephyr-projects/zephyr/soc/renesas/rcar/Kconfig.defconfig"
osource "C:/Users/sahan/zephyr-projects/zephyr/soc/renesas/ra/Kconfig.defconfig"
osource "C:/Users/sahan/zephyr-projects/zephyr/soc/realtek/ec/Kconfig.defconfig"
osource "C:/Users/sahan/zephyr-projects/zephyr/soc/raspberrypi/rpi_pico/Kconfig.defconfig"
osource "C:/Users/sahan/zephyr-projects/zephyr/soc/quicklogic/eos_s3/Kconfig.defconfig"
osource "C:/Users/sahan/zephyr-projects/zephyr/soc/qemu/virt_riscv/Kconfig.defconfig"
osource "C:/Users/sahan/zephyr-projects/zephyr/soc/qemu/malta/Kconfig.defconfig"
osource "C:/Users/sahan/zephyr-projects/zephyr/soc/openisa/rv32m1/Kconfig.defconfig"
osource "C:/Users/sahan/zephyr-projects/zephyr/soc/openhwgroup/cva6/Kconfig.defconfig"
osource "C:/Users/sahan/zephyr-projects/zephyr/soc/oct/osd32mp15x/Kconfig.defconfig"
osource "C:/Users/sahan/zephyr-projects/zephyr/soc/nxp/s32/Kconfig.defconfig"
osource "C:/Users/sahan/zephyr-projects/zephyr/soc/nxp/rw/Kconfig.defconfig"
osource "C:/Users/sahan/zephyr-projects/zephyr/soc/nxp/mcx/Kconfig.defconfig"
osource "C:/Users/sahan/zephyr-projects/zephyr/soc/nxp/lpc/Kconfig.defconfig"
osource "C:/Users/sahan/zephyr-projects/zephyr/soc/nxp/layerscape/Kconfig.defconfig"
osource "C:/Users/sahan/zephyr-projects/zephyr/soc/nxp/kinetis/Kconfig.defconfig"
osource "C:/Users/sahan/zephyr-projects/zephyr/soc/nxp/imxrt/Kconfig.defconfig"
osource "C:/Users/sahan/zephyr-projects/zephyr/soc/nxp/imx/Kconfig.defconfig"
osource "C:/Users/sahan/zephyr-projects/zephyr/soc/nuvoton/numicro/Kconfig.defconfig"
osource "C:/Users/sahan/zephyr-projects/zephyr/soc/nuvoton/numaker/Kconfig.defconfig"
osource "C:/Users/sahan/zephyr-projects/zephyr/soc/nuvoton/npcx/Kconfig.defconfig"
osource "C:/Users/sahan/zephyr-projects/zephyr/soc/nuvoton/npcm/Kconfig.defconfig"
osource "C:/Users/sahan/zephyr-projects/zephyr/soc/nordic/Kconfig.defconfig"
osource "C:/Users/sahan/zephyr-projects/zephyr/soc/neorv32/Kconfig.defconfig"
osource "C:/Users/sahan/zephyr-projects/zephyr/soc/native/inf_clock/Kconfig.defconfig"
osource "C:/Users/sahan/zephyr-projects/zephyr/soc/microchip/sam/Kconfig.defconfig"
osource "C:/Users/sahan/zephyr-projects/zephyr/soc/microchip/miv/Kconfig.defconfig"
osource "C:/Users/sahan/zephyr-projects/zephyr/soc/microchip/mec/Kconfig.defconfig"
osource "C:/Users/sahan/zephyr-projects/zephyr/soc/mediatek/mt8xxx/Kconfig.defconfig"
osource "C:/Users/sahan/zephyr-projects/zephyr/soc/lowrisc/opentitan/Kconfig.defconfig"
osource "C:/Users/sahan/zephyr-projects/zephyr/soc/litex/litex_vexriscv/Kconfig.defconfig"
osource "C:/Users/sahan/zephyr-projects/zephyr/soc/ite/ec/Kconfig.defconfig"
osource "C:/Users/sahan/zephyr-projects/zephyr/soc/intel/raptor_lake/Kconfig.defconfig"
osource "C:/Users/sahan/zephyr-projects/zephyr/soc/intel/lakemont/Kconfig.defconfig"
osource "C:/Users/sahan/zephyr-projects/zephyr/soc/intel/intel_socfpga_std/Kconfig.defconfig"
osource "C:/Users/sahan/zephyr-projects/zephyr/soc/intel/intel_socfpga/Kconfig.defconfig"
osource "C:/Users/sahan/zephyr-projects/zephyr/soc/intel/intel_niosv/Kconfig.defconfig"
osource "C:/Users/sahan/zephyr-projects/zephyr/soc/intel/intel_ish/Kconfig.defconfig"
osource "C:/Users/sahan/zephyr-projects/zephyr/soc/intel/intel_adsp/Kconfig.defconfig"
osource "C:/Users/sahan/zephyr-projects/zephyr/soc/intel/elkhart_lake/Kconfig.defconfig"
osource "C:/Users/sahan/zephyr-projects/zephyr/soc/intel/atom/Kconfig.defconfig"
osource "C:/Users/sahan/zephyr-projects/zephyr/soc/intel/apollo_lake/Kconfig.defconfig"
osource "C:/Users/sahan/zephyr-projects/zephyr/soc/intel/alder_lake/Kconfig.defconfig"
osource "C:/Users/sahan/zephyr-projects/zephyr/soc/infineon/cat3/Kconfig.defconfig"
osource "C:/Users/sahan/zephyr-projects/zephyr/soc/infineon/cat1c/Kconfig.defconfig"
osource "C:/Users/sahan/zephyr-projects/zephyr/soc/infineon/cat1b/Kconfig.defconfig"
osource "C:/Users/sahan/zephyr-projects/zephyr/soc/infineon/cat1a/Kconfig.defconfig"
osource "C:/Users/sahan/zephyr-projects/zephyr/soc/gd/gd32/Kconfig.defconfig"
osource "C:/Users/sahan/zephyr-projects/zephyr/soc/gaisler/leon3/Kconfig.defconfig"
osource "C:/Users/sahan/zephyr-projects/zephyr/soc/gaisler/gr716a/Kconfig.defconfig"
osource "C:/Users/sahan/zephyr-projects/zephyr/soc/espressif/Kconfig.defconfig"
osource "C:/Users/sahan/zephyr-projects/zephyr/soc/ene/kb1200/Kconfig.defconfig"
osource "C:/Users/sahan/zephyr-projects/zephyr/soc/ene/kb106x/Kconfig.defconfig"
osource "C:/Users/sahan/zephyr-projects/zephyr/soc/efinix/sapphire/Kconfig.defconfig"
osource "C:/Users/sahan/zephyr-projects/zephyr/soc/cdns/xtensa_sample_controller/Kconfig.defconfig"
osource "C:/Users/sahan/zephyr-projects/zephyr/soc/cdns/sample_controller32/Kconfig.defconfig"
osource "C:/Users/sahan/zephyr-projects/zephyr/soc/cdns/dc233c/Kconfig.defconfig"
osource "C:/Users/sahan/zephyr-projects/zephyr/soc/brcm/bcmvk/Kconfig.defconfig"
osource "C:/Users/sahan/zephyr-projects/zephyr/soc/brcm/bcm2712/Kconfig.defconfig"
osource "C:/Users/sahan/zephyr-projects/zephyr/soc/brcm/bcm2711/Kconfig.defconfig"
osource "C:/Users/sahan/zephyr-projects/zephyr/soc/bflb/Kconfig.defconfig"
osource "C:/Users/sahan/zephyr-projects/zephyr/soc/atmel/sam0/Kconfig.defconfig"
osource "C:/Users/sahan/zephyr-projects/zephyr/soc/atmel/sam/Kconfig.defconfig"
osource "C:/Users/sahan/zephyr-projects/zephyr/soc/aspeed/Kconfig.defconfig"
osource "C:/Users/sahan/zephyr-projects/zephyr/soc/arm/Kconfig.defconfig"
osource "C:/Users/sahan/zephyr-projects/zephyr/soc/arm/beetle/Kconfig.defconfig"
osource "C:/Users/sahan/zephyr-projects/zephyr/soc/antmicro/myra/Kconfig.defconfig"
osource "C:/Users/sahan/zephyr-projects/zephyr/soc/andestech/Kconfig.defconfig"
osource "C:/Users/sahan/zephyr-projects/zephyr/soc/amd/acp_6_0/Kconfig.defconfig"
osource "C:/Users/sahan/zephyr-projects/zephyr/soc/ambiq/Kconfig.defconfig"
osource "C:/Users/sahan/zephyr-projects/zephyr/soc/aesc/Kconfig.defconfig"
osource "C:/Users/sahan/zephyr-projects/zephyr/soc/adi/max32/Kconfig.defconfig"
```
